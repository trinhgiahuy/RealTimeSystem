## build/conf/bblayers.conf
```bitbake
# POKY_BBLAYERS_CONF_VERSION is increased each time build/conf/bblayers.conf
# changes incompatibly
POKY_BBLAYERS_CONF_VERSION = "2"

BBPATH = "${TOPDIR}"
BBFILES ?= ""

BBLAYERS ?= " \
  /home/student/16/poky/meta \
  /home/student/16/poky/meta-poky \
  /home/student/16/poky/meta-yocto-bsp \
  /home/student/16/meta-pynq \
  /home/student/16/meta-xilinx/meta-xilinx-bsp \
  /home/student/16/meta-xilinx/meta-xilinx-contrib \
  "
```

## meta-group16/conf/layer.conf
```bitbake
# We have a conf and classes directory, add to BBPATH
BBPATH .= ":${LAYERDIR}"

# We have recipes-* directories, add to BBFILES
BBFILES += "${LAYERDIR}/recipes-*/*/*.bb \
            ${LAYERDIR}/recipes-*/*/*.bbappend"

BBFILE_COLLECTIONS += "../meta-group16"
BBFILE_PATTERN_../meta-group16 = "^${LAYERDIR}/"
BBFILE_PRIORITY_../meta-group16 = "6"
```

## meta-tie50307/conf/layer.conf
```bitbake
# We have a conf and classes directory, add to BBPATH
BBPATH .= ":${LAYERDIR}"

# We have recipes-* directories, add to BBFILES
BBFILES += "${LAYERDIR}/recipes-*/*/*.bb \
            ${LAYERDIR}/recipes-*/*/*.bbappend"

BBFILE_COLLECTIONS += "meta-tie50307"
BBFILE_PATTERN_meta-tie50307 = "^${LAYERDIR}/"
BBFILE_PRIORITY_meta-tie50307 = "6"
LAYERDEPENDS_meta-tie50307 = "pynq"
```
